#include <Wire.h>
#include <U8g2lib.h>
#include <WiFi.h>

#define LED_PIN 2  // LED en pin digital 2

U8G2_SH1106_128X64_NONAME_F_SW_I2C oled(U8G2_R0, /* clock=*/9, /* data=*/8, /* reset=*/U8X8_PIN_NONE);

int currentNetwork = 0;
int n = 0;
unsigned long lastScan = 0;
unsigned long lastChange = 0;
const unsigned long scanInterval = 15000;
const unsigned long displayInterval = 2500;

// Logo UVG (64x64 px aprox)
const unsigned char uvg_logo [] PROGMEM = {
  0xff, 0x1f, 0x00, 0x00, 0x00, 0x00, 0x00, 0x00, 0x00, 0x00, 0x00, 0x00, 0x00, 0x00, 0xf8, 0xff, 
	0xff, 0x1f, 0x00, 0x00, 0x00, 0x00, 0x00, 0x00, 0x00, 0x00, 0x00, 0x00, 0x00, 0x00, 0xf8, 0xff, 
	0xff, 0x1f, 0x00, 0x00, 0x00, 0x00, 0x00, 0x00, 0x00, 0x00, 0x00, 0x00, 0x00, 0x00, 0xf8, 0xff, 
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	0xff, 0x1f, 0x00, 0x00, 0x00, 0x00, 0x00, 0x00, 0x00, 0x00, 0x00, 0x00, 0x00, 0x00, 0xf8, 0xff
};

const unsigned char jack [] PROGMEM = {
	0xff, 0xff, 0xff, 0xff, 0xff, 0xff, 0xff, 0xff, 0xff, 0xff, 0xff, 0xff, 0xff, 0xff, 0xff, 0xff, 
	0xff, 0xff, 0xff, 0xff, 0xff, 0xff, 0xff, 0xff, 0xff, 0xff, 0xff, 0xff, 0xff, 0xff, 0xff, 0xff, 
	0xff, 0xff, 0xff, 0xff, 0xff, 0xff, 0xff, 0xff, 0xcf, 0xff, 0xff, 0xff, 0xff, 0xff, 0xff, 0xff, 
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	0xff, 0xff, 0xff, 0xff, 0xff, 0xff, 0x77, 0xf8, 0xff, 0x8c, 0xff, 0xf1, 0xff, 0xff, 0xff, 0xff
};

void showWelcomeMessage() {
  oled.clearBuffer();
  oled.drawXBMP(0, 0, 128, 64, uvg_logo);  // Mostrar logo UVG centrado
  oled.sendBuffer();
  delay(2000);

  oled.clearBuffer();
  oled.drawXBMP(0, 0, 128, 64, jack);  // Mostrar jack centrado
  oled.sendBuffer();
  delay(2000);

  oled.clearBuffer();
  oled.setFont(u8g2_font_6x10_tr);
  oled.drawStr(0, 20, "Bienvenido al Sniffer");
  oled.drawStr(0, 35, "AR UVG TOUR");
  oled.drawStr(0, 50, "ESP32 WiFi Scanner");
  oled.sendBuffer();
  delay(2500);
}

String getEncryptionType(int enc) {
  switch (enc) {
    case WIFI_AUTH_OPEN: return "Open";
    case WIFI_AUTH_WEP: return "WEP";
    case WIFI_AUTH_WPA_PSK: return "WPA";
    case WIFI_AUTH_WPA2_PSK: return "WPA2";
    case WIFI_AUTH_WPA_WPA2_PSK: return "WPA/WPA2";
    case WIFI_AUTH_WPA2_ENTERPRISE: return "Enterprise";
    default: return "Unknown";
  }
}

void scanNetworks() {
  // Parpadeo rápido mientras escanea
  for (int i = 0; i < 6; i++) {
    digitalWrite(LED_PIN, HIGH);
    delay(100);
    digitalWrite(LED_PIN, LOW);
    delay(100);
  }

  WiFi.scanDelete();
  n = WiFi.scanNetworks(false, true);
  currentNetwork = 0;

  if (n > 0) {
    digitalWrite(LED_PIN, HIGH);
  } else {
    digitalWrite(LED_PIN, LOW);
  }
}

void updateScanIfNeeded() {
  if (millis() - lastScan > scanInterval) {
    scanNetworks();
    lastScan = millis();
  }
}

void updateDisplayIfNeeded() {
  if (n == 0) {
    oled.clearBuffer();
    oled.setFont(u8g2_font_haxrcorp4089_t_cyrillic);
    oled.drawStr(0, 30, "No se detectaron redes");
    oled.sendBuffer();
    return;
  }

  if (millis() - lastChange > displayInterval) {
    oled.clearBuffer();
    oled.setFont(u8g2_font_5x7_tf);

    String ssid = WiFi.SSID(currentNetwork);
    int rssi = WiFi.RSSI(currentNetwork);
    int channel = WiFi.channel(currentNetwork);
    int enc = WiFi.encryptionType(currentNetwork);
    String encryption = getEncryptionType(enc);

    oled.drawStr(0, 7, ("SSID: " + ssid).c_str());
    oled.drawStr(0, 22, ("RSSI: " + String(rssi) + " dBm").c_str());
    oled.drawStr(0, 37, ("CH: " + String(channel)).c_str());
    oled.drawStr(0, 52, ("ENC: " + encryption).c_str());

    String count = "Red " + String(currentNetwork + 1) + "/" + String(n);
    oled.drawStr(0, 64, count.c_str());

    oled.sendBuffer();

    currentNetwork = (currentNetwork + 1) % n;
    lastChange = millis();
  }
}

void setup() {
  pinMode(LED_PIN, OUTPUT);
  digitalWrite(LED_PIN, LOW);

  Wire.begin(8, 9);
  oled.begin();
  oled.setFont(u8g2_font_haxrcorp4089_t_cyrillic);

  WiFi.mode(WIFI_STA);
  WiFi.disconnect(true);
  delay(1000);

  showWelcomeMessage();

  scanNetworks();
  lastScan = millis();
  lastChange = millis();
}

void loop() {
  updateScanIfNeeded();
  updateDisplayIfNeeded();
}
